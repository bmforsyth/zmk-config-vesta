## boards/shields/vesta/Kconfig.defconfig
```kconfig
if SHIELD_VESTA_LEFT

# Name must be less than 16 characters long!
config ZMK_KEYBOARD_NAME
    default "Vesta"

config ZMK_SPLIT_ROLE_CENTRAL
    default y

endif

if SHIELD_VESTA_LEFT || SHIELD_VESTA_RIGHT

config ZMK_SPLIT
    default y

endif
```

## boards/shields/vesta/Kconfig.shield
```kconfig
config SHIELD_VESTA_LEFT
    def_bool $(shields_list_contains,vesta_left)

config SHIELD_VESTA_RIGHT
    def_bool $(shields_list_contains,vesta_right)
```
